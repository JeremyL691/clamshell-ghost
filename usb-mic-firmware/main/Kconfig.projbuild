## usb-mic-firmware/main/Kconfig.projbuild
```kconfig
menu "Clamshell Ghost ESP32 Microphone Configuration"

    config ESP32_WIFI_SSID
        string "Fallback Wi-Fi SSID"
        default ""
        help
            Fallback Wi-Fi SSID for station mode.
            Credentials stored in the NVS "wifi" namespace ("ssid"/"password" or
            "ssid0"/"password0") or standard ESP-IDF Wi-Fi NVS take priority.
            This Kconfig value is used only when NVS has no stored credentials.

    config ESP32_WIFI_PASSWORD
        string "Fallback Wi-Fi Password"
        default ""
        help
            Fallback Wi-Fi password corresponding to CONFIG_ESP32_WIFI_SSID.

    config ESP32_DEFAULT_MAC_IP
        string "Initial Target Mac IPv4 Address"
        default "255.255.255.255"
        help
            Initial destination IPv4 address for UDP audio and heartbeat packets on
            port 18796 before Mac discovery completes. The ESP32 automatically
            discovers the Mac via UDP broadcast on port 18796 and locks onto the
            Mac's unicast IP as soon as a MAC_ACK_CTRL packet is received.

endmenu
```

## usb-mic-firmware/sdkconfig.defaults
```kconfig
CONFIG_IDF_TARGET="esp32s3"

# Flash & PSRAM (Waveshare ESP32-S3-Touch-AMOLED-1.75C)
CONFIG_ESPTOOLPY_FLASHSIZE_16MB=y
CONFIG_ESPTOOLPY_FLASHMODE_QIO=y
CONFIG_ESPTOOLPY_FLASHFREQ_80M=y
CONFIG_SPIRAM=y
CONFIG_SPIRAM_MODE_OCT=y
CONFIG_SPIRAM_SPEED_80M=y

# CPU Frequency & Power Management
CONFIG_ESP_DEFAULT_CPU_FREQ_MHZ_160=y
CONFIG_FREERTOS_HZ=1000
CONFIG_COMPILER_OPTIMIZATION_PERF=y

# USB Device UAC (Mac Dedicated Pure Microphone)
CONFIG_UAC_TUSB_VID=0x303A
CONFIG_UAC_TUSB_PID=0x8001
CONFIG_UAC_TUSB_MANUFACTURER="Waveshare"
CONFIG_UAC_TUSB_PRODUCT="ESP32-S3 Dual Microphone"
CONFIG_UAC_TUSB_SERIAL_NUM="WS175CMIC01"
CONFIG_UAC_SPEAKER_CHANNEL_NUM=0
CONFIG_UAC_MIC_CHANNEL_NUM=1
CONFIG_UAC_SAMPLE_RATE=48000
CONFIG_UAC_BIT_RESOLUTION_16=y
CONFIG_UAC_MIC_INTERVAL_MS=10
CONFIG_UAC_SUPPORT_MACOS=y
CONFIG_UAC_TINYUSB_TASK_CORE=0
CONFIG_UAC_MIC_TASK_CORE=1
CONFIG_UAC_TINYUSB_TASK_PRIORITY=6
CONFIG_UAC_MIC_TASK_PRIORITY=6

# Keep UART0 for log (do not conflict with USB OTG on GPIO19/20)
CONFIG_ESP_CONSOLE_UART_DEFAULT=y
CONFIG_ESP_CONSOLE_SECONDARY_NONE=y
```
